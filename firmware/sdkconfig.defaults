## firmware/sdkconfig.defaults
```kconfig
# COSMO CIA — ESP-IDF sdkconfig defaults

# Target
CONFIG_IDF_TARGET="esp32s3"

# CPU
CONFIG_ESP32S3_DEFAULT_CPU_FREQ_240=y

# Wi-Fi
CONFIG_ESP_WIFI_STATIC_RX_BUFFER_NUM=10
CONFIG_ESP_WIFI_DYNAMIC_RX_BUFFER_NUM=32

# HTTPS / TLS
CONFIG_ESP_TLS_USING_MBEDTLS=y
CONFIG_MBEDTLS_SSL_MAX_CONTENT_LEN=16384

# Partition table
CONFIG_PARTITION_TABLE_CUSTOM=y
CONFIG_PARTITION_TABLE_CUSTOM_FILENAME="partitions.csv"

# OTA
CONFIG_BOOTLOADER_APP_ROLLBACK_ENABLE=y
CONFIG_BOOTLOADER_APP_ANTI_ROLLBACK=n

# Camera
CONFIG_CAMERA_TASK_STACK_SIZE=4096

# Log level
CONFIG_LOG_DEFAULT_LEVEL_INFO=y

# UART debug (disable in production build)
CONFIG_ESP_CONSOLE_UART_DEFAULT=y
CONFIG_ESP_CONSOLE_UART_NUM=0
CONFIG_ESP_CONSOLE_UART_BAUDRATE=115200

# NVS encryption (enable in production)
CONFIG_NVS_ENCRYPTION=n
```
